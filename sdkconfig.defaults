## sdkconfig.defaults
```kconfig
# sdkconfig.defaults - společné nastavení pro Matter aplikaci

CONFIG_IDF_TARGET="esp32c6"

# Partition table s dostatkem místa pro Matter/Thread data
CONFIG_PARTITION_TABLE_CUSTOM=y
CONFIG_PARTITION_TABLE_CUSTOM_FILENAME="partitions.csv"

# Velikost flash pameti - vetsina ESP32-C6 vyvojovych desek ma 8MB.
# Pokud ma tvoje deska jen 4MB, zmen na "4MB" (a preveř, ze se partitions.csv vejde).
CONFIG_ESPTOOLPY_FLASHSIZE_8MB=y
CONFIG_ESPTOOLPY_FLASHSIZE="8MB"

# Zaklad Matter
CONFIG_ENABLE_MATTER_SERVER=y
CONFIG_ENABLE_CHIP_SHELL=n

# BLE pro commissioning (parovani pres QR kod / setup kod)
CONFIG_BT_ENABLED=y
CONFIG_BT_NIMBLE_ENABLED=y

# mbedTLS nastaveni doporucena Matter SDK
CONFIG_MBEDTLS_CERTIFICATE_BUNDLE=y
```

## sdkconfig.defaults.esp32c6_thread
```kconfig
# sdkconfig.defaults.esp32c6_thread
# Pouzij spolu se zakladnim sdkconfig.defaults:
#   idf.py -DSDKCONFIG_DEFAULTS="sdkconfig.defaults;sdkconfig.defaults.esp32c6_thread" set-target esp32c6

# --- Zapnuti OpenThread, vypnuti Wi-Fi transportu ---
CONFIG_OPENTHREAD_ENABLED=y
CONFIG_OPENTHREAD_SRP_CLIENT=y
CONFIG_OPENTHREAD_DNS_CLIENT=y
CONFIG_OPENTHREAD_LOG_LEVEL_DYNAMIC=n
CONFIG_OPENTHREAD_LOG_LEVEL_NOTE=y
CONFIG_OPENTHREAD_CLI=y

CONFIG_ENABLE_WIFI_STATION=n
CONFIG_ENABLE_WIFI_AP=n

# --- mDNS a IPv6 nastaveni potrebne pro Thread ---
# Overeno proti realnemu fungujicimu projektu (TLED, github.com/maui1911/TLED) -
# jejich generovany sdkconfig ma USE_MINIMAL_MDNS vypnute (plna ESP-IDF mdns
# komponenta) a LWIP_IPV6_AUTOCONFIG take vypnute. Predchozi pokusy zmenit
# tohle byly spatne - vracim na hodnoty z overeneho funkcniho projektu.
CONFIG_USE_MINIMAL_MDNS=n
CONFIG_ENABLE_EXTENDED_DISCOVERY=y
CONFIG_LWIP_IPV6_AUTOCONFIG=n
CONFIG_LWIP_IPV6_NUM_ADDRESSES=8
CONFIG_LWIP_MULTICAST_PING=y

# --- KLICOVY CHYBEJICI FLAG ---
# Nalezeno v realnem funkcnim projektu (TLED) - tenhle flag jsme nikdy
# nemeli nastaveny! Je to samostatna volba nezavisla na CONFIG_OPENTHREAD_ENABLED,
# ktera pravdepodobne prepina DNS-SD/discovery vrstvu na SRP-based registraci
# (misto standardniho mDNS multicastu, ktery pres Thread mesh nefunguje).
# Tohle je nejpravdepodobnejsi pricina chyby "Operational advertising failed: 3".
CONFIG_ENABLE_MATTER_OVER_THREAD=y

# --- 802.15.4 radio na ESP32-C6 ---
CONFIG_IEEE802154_ENABLED=y
```
